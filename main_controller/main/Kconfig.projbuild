## main_controller/main/Kconfig.projbuild
```kconfig
menu "My WIFI"
    menu "Wifi Connect"
        config CONNECT_WIFI
            bool CONNECT_WIFI
            default true

        config SSID
            string "SSID"
            default "my ssid"

        config PASSWORD
            string "PASSWORD"
            default "my password"
    endmenu

    menu "WifiAp Setup"
        config SET_WIFI_AP
            bool SET_WIFI_AP
            default true

        config AP_SSID
            string "AP_SSID"
            default my_ssid

        config AP_PASSWORD
            string "AP_PASSWORD"
            default my_password

        config ESP_WIFI_CHANNEL
            int "WiFi Channel"
            range 1 13
            default 1

        config AP_MAX_CONN
            int "AP_MAX_CONN"
            default 4
    endmenu
endmenu

menu "MY_RTC_Config"
    config SCLK_PIN
        int SCLK_PIN
        default 0

    config CE_PIN
        int CE_PIN
        default 2

    config IO_PIN
        int IO_PIN
        default 4
endmenu

menu "MY_POSTURE_SYS_CONFIG"
    config WEIGTH_FACTOR
        int WEIGTH_FACTOR
        default 34

    config COUNTABLE_WEIGHT
        int COUNTABLE_WEIGHT
        default 400

    config MIN_COUNTABLE_WEIGHTS
        int MIN_COUNTABLE_WEIGHTS
        default 4
    
    config MAX_NOT_SIT_TIME
        int "MAX_NOT_SIT_TIME in seconds"
        default 5
endmenu
```
